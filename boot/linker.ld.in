/* Path /boot/linker.ld         */
/* Link scription of kernel.    */

ENTRY(_start)

SECTIONS
{
    . = @KERNEL_POS@;

    .text : {
        *(.entry)
        *(.text)
    } :text

    .rodata : { *(.rodata) } : text
    .data : { *(.data) } : data

    .bss : {
        *(COMMON)
        *(.bss)

        . = ALIGN(16);
        _stack_bottom = .;
        . += @KERNEL_STACK_SIZE@;
        _stack_top = .;
    } : data
}

PHDRS {
    text PT_LOAD FLAGS(5);
    data PT_LOAD FLAGS(6);
}
